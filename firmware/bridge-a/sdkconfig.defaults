## firmware/bridge-a/sdkconfig.defaults
```kconfig
CONFIG_IDF_TARGET="esp32s3"
CONFIG_ESPTOOLPY_FLASHSIZE_16MB=y
CONFIG_SPIRAM=y
CONFIG_SPIRAM_MODE_OCT=y
CONFIG_TINYUSB_CDC_ENABLED=y
CONFIG_TINYUSB_CDC_COUNT=1
CONFIG_TINYUSB_CDC_RX_BUFSIZE=512
CONFIG_TINYUSB_CDC_TX_BUFSIZE=256
CONFIG_BRIDGE_TEST_FIXTURE=n
CONFIG_LOG_DEFAULT_LEVEL_WARN=y
CONFIG_FREERTOS_HZ=1000
```

## firmware/bridge-b/sdkconfig.defaults
```kconfig
CONFIG_IDF_TARGET="esp32s3"
CONFIG_ESPTOOLPY_FLASHSIZE_16MB=y
CONFIG_SPIRAM=y
CONFIG_SPIRAM_MODE_OCT=y
CONFIG_TINYUSB_HID_COUNT=1
CONFIG_TINYUSB_DESC_USE_ESPRESSIF_VID=y
CONFIG_TINYUSB_DESC_MANUFACTURER_STRING="DreamMakers2"
CONFIG_TINYUSB_DESC_PRODUCT_STRING="Wireless Keyboard Bridge B"
CONFIG_BRIDGE_TEST_FIXTURE=n
CONFIG_LOG_DEFAULT_LEVEL_WARN=y
CONFIG_FREERTOS_HZ=1000
```

## firmware/common/Kconfig
```kconfig
menu "Keyboard bridge"
config BRIDGE_TEST_FIXTURE
    bool "Build nondeployable test fixture"
    default n
    help
        Allows a compile-only dummy pair configuration. The resulting image
        deliberately has no ESP-NOW or HID output and must never be flashed.
endmenu
```
